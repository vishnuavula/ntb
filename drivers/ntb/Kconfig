## drivers/ntb/Kconfig
```kconfig
menuconfig NTB
       tristate "Non-Transparent Bridge support"
       depends on PCI
       help
        The PCI-E Non-transparent bridge hardware is a point-to-point PCI-E bus
        connecting 2 systems.  When configured, writes to the device's PCI
        mapped memory will be mirrored to a buffer on the remote system.  The
        ntb Linux driver uses this point-to-point communication as a method to
        transfer data from one system to the other.

        If unsure, say N.

if NTB

comment "NTB Devices"

config NTB_XEON
       tristate "Intel Xeon Non-Transparent Bridge support"
       depends on NTB
       depends on X86
       help
	This driver supports Intel Xeon family of Non-Transparent Bridge devices

        If unsure, say N.

config NTB_ATOM
       tristate "Intel Atom Non-Transparent Bridge support"
       depends on NTB
       depends on X86
       help
	This driver supports Intel Atom family of Non-Transparent Bridge devices

        If unsure, say N.

endif
```

## drivers/pci/ntb/Kconfig
```kconfig
menu "Non-Transparent Bridge Support (EXPERIMENTAL)"

config NTB
	tristate
	default n
	depends on PCI && X86 && EXPERIMENTAL

config NTB_B2B
	tristate "NTB Back to Back Mode"
	depends on PCI && X86 && EXPERIMENTAL
	select NTB
	help
	  This is the NTB mode where both hosts have NTB hardware and they
	  are connected to each other.

config NTB_RP
	tristate "NTB Classic Mode"
	depends on PCI && X86 && EXPERIMENTAL
	select NTB
	help
	  This is the classic NTB mode where only the primary host has the
	  NTB hardware. This is the mode for the primary host.

config RP_NTB 
	tristate "NTB Rootport Mode"
	depends on PCI && X86 && EXPERIMENTAL
	select NTB
	help
	  This is the classic NTB mode where only the primary host has the
	  NTB hardware. This is the mode for the secondary host that only
	  has the root port.

config NTB_ETH 
	tristate "ntbeth: NTB to Ethernet emulation"
	depends on PCI && X86 && EXPERIMENTAL
	help
	  ntbeth is a Linux network driver that uses NTB PCI-E Link as
	  point-to-point link between two electrically separated
	  systems. The driver registers itself as Ethernet driver into
	  the Linux TCP/IP stack.  Primary purpose of this driver is to
	  show how NTB link can be used as connection link between two
	  systems to exchange data using NTB provided Windows into
	  remote system and use door bells to provide asynchronous
	  notifications to remote system

	  If you are building the kernel for a Jasper Forest or Jaketown
	  system say Y

	  If unsure, say N

endmenu
```
